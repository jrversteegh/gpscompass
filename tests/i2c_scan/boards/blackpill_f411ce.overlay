/*
 * Copyright (c) 2019 Nordic Semiconductor ASA
 *
 * SPDX-License-Identifier: Apache-2.0
 */

&i2c1 {
    clock-frequency = <I2C_BITRATE_FAST>;
};

&i2c2 {
    pinctrl-0 = <&i2c2_scl_pb10 &i2c2_sda_pb3>;
    pinctrl-names = "default";
    status = "okay";
    clock-frequency = <I2C_BITRATE_FAST>;
};
